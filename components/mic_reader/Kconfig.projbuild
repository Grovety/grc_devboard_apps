## components/mic_reader/Kconfig.projbuild
```kconfig
menu "Microphone Configuration"
    config MIC_SAMPLE_RATE
        int "Microphone sample rate"
        default 16000
        help
            Sample rete used in microphone.

    choice MIC_CHANNEL
        prompt "Microphone channel configuration"
        default MIC_CHANNEL_BOTH

        config MIC_CHANNEL_RIGHT
            bool "RIGHT"
        config MIC_CHANNEL_LEFT
            bool "LEFT"
        config MIC_CHANNEL_BOTH
            bool "BOTH"
    endchoice

endmenu
```

## main/Kconfig.projbuild
```kconfig
menu "App Configuration"

    choice TARGET
        prompt "Target device"
        default TARGET_GRC_DEVBOARD

        config TARGET_GRC_DEVBOARD
            bool "GRC_DEVBOARD"
        config TARGET_AI_MODULE
            bool "AI_MODULE"

    endchoice

    choice APP
        prompt "Example application"
        default APP_VOICE_RELAY

        config APP_VOICE_RELAY
            bool "VOICE_RELAY"
        config APP_SOUND_EVENTS_DETECTION
            bool "SOUND_EVENTS_DETECTION"
        config APP_AI_TEACHER
            bool "AI_TEACHER"

    endchoice

    config KWS_SAMPLE_RATE
        depends on APP_VOICE_RELAY || APP_AI_TEACHER
        int "KWS sample rate"
        default 16000
        help
            Sample rete used in KWS.


    choice SOUND_EVENTS_TYPE
        depends on APP_SOUND_EVENTS_DETECTION
        prompt "Type of sounds to detect"
        default SOUND_EVENTS_BABY_CRY

        config SOUND_EVENTS_BABY_CRY
            bool "BABY_CRY"
        config SOUND_EVENTS_GLASS_BREAKING
            bool "GLASS_BREAKING"
        config SOUND_EVENTS_BARK
            bool "BARK"
        config SOUND_EVENTS_COUGHING
            bool "COUGHING"

    endchoice

endmenu
```
